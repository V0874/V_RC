# file: V_RC.ioc
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Mcu.Family=STM32F4
Mcu.Name=STM32F411C(C-E)Ux
Mcu.Package=UFQFPN48
NVIC.PriorityGroup=NVIC_PRIORITYGROUP_4
PA13.Mode=Serial_Wire
PA13.Signal=SYS_JTMS-SWDIO
PA14.Mode=Serial_Wire
PA14.Signal=SYS_JTCK-SWCLK
ProjectManager.HeapSize=0x200
ProjectManager.StackSize=0x400
ProjectManager.TargetToolchain=Makefile
RCC.AHBFreq_Value=16000000
RCC.APB1Freq_Value=16000000
RCC.APB2Freq_Value=16000000
RCC.CortexFreq_Value=16000000
RCC.HSE_VALUE=25000000
RCC.HSI_VALUE=16000000
RCC.LSE_VALUE=32768
RCC.SYSCLKFreq_VALUE=16000000
RCC.VCOOutputFreq_Value=192000000
board=custom

// file: Core/Src/main.c
/* USER CODE BEGIN Header */
/**
  ******************************************************************************
  * @file           : main.c
  * @brief          : Main program body
  ******************************************************************************
  * @attention
  *
  * Copyright (c) 2025 STMicroelectronics.
  * All rights reserved.
  *
  * This software is licensed under terms that can be found in the LICENSE file
  * in the root directory of this software component.
  * If no LICENSE file comes with this software, it is provided AS-IS.
  *
  ******************************************************************************
  */
/* USER CODE END Header */
#include "main.h"

void SystemClock_Config(void);
static void MX_GPIO_Init(void);

int main(void)
{

  /* USER CODE BEGIN 1 */

  I2C_HandleTypeDef hi2c = {0};

  TIM_HandleTypeDef timer = {0};

  UART_HandleTypeDef huart = {0};

  ADC_HandleTypeDef adc = {0};

  ADC_ChannelConfTypeDef adc_conf = {0};

  volatile uint32_t y_axis = 0;
  volatile uint32_t x_axis = 0;

  uint8_t adc_ybuff[4] = {0};
  uint8_t adc_xbuff[4] = {0};

  uint8_t y_msg[] = "ADC Y Value: ";
  uint8_t x_msg[] = "ADC X Value: ";

  bool conv_x_ready = false;

  /* USER CODE END 1 */

  /* MCU Configuration--------------------------------------------------------*/

  /* Reset of all peripherals, Initializes the Flash interface and the Systick. */
  HAL_Init();

  /* Configure the system clock */
  SystemClock_Config();

  /* Initialize all configured peripherals */
  MX_GPIO_Init();
  /* USER CODE BEGIN 2 */

  uart_init(&huart);

  adc_init(&adc, &adc_conf);

  timer4_init(&timer);

  /* USER CODE END 2 */

  /* Infinite loop */

  while (1)
  {

    /* USER CODE BEGIN 3 */

    HAL_ADC_Start(&adc);

    if(HAL_ADC_PollForConversion(&adc, HAL_MAX_DELAY) == HAL_OK && conv_x_ready == false){
      y_axis = HAL_ADC_GetValue(&adc);
      adc_change_ch(&adc, &adc_conf, ADC_CHANNEL_1);
      HAL_ADC_Start(&adc);
      utoa(adc_ybuff, y_axis, 4);
      conv_x_ready = true;

      HAL_UART_Transmit(&huart, y_msg, sizeof(y_msg) - 1, HAL_MAX_DELAY);
      HAL_UART_Transmit(&huart, adc_ybuff, sizeof(adc_ybuff), HAL_MAX_DELAY);
    }

    if(HAL_ADC_PollForConversion(&adc, HAL_MAX_DELAY) == HAL_OK && conv_x_ready == true){
      x_axis = HAL_ADC_GetValue(&adc);
      adc_change_ch(&adc, &adc_conf, ADC_CHANNEL_0);
      HAL_ADC_Start(&adc);
      utoa(adc_xbuff, x_axis, 4);
      conv_x_ready = false;

      HAL_UART_Transmit(&huart, x_msg, sizeof(x_msg) - 1, HAL_MAX_DELAY);
      HAL_UART_Transmit(&huart, adc_xbuff, sizeof(adc_xbuff), HAL_MAX_DELAY);
    }
  }
  /* USER CODE END 3 */
}

void SystemClock_Config(void)
{
  RCC_OscInitTypeDef RCC_OscInitStruct = {0};
  RCC_ClkInitTypeDef RCC_ClkInitStruct = {0};

  /** Configure the main internal regulator output voltage
  */
  __HAL_RCC_PWR_CLK_ENABLE();
  __HAL_PWR_VOLTAGESCALING_CONFIG(PWR_REGULATOR_VOLTAGE_SCALE1);

  /** Initializes the RCC Oscillators according to the specified parameters
  * in the RCC_OscInitTypeDef structure.
  */
  RCC_OscInitStruct.OscillatorType = RCC_OSCILLATORTYPE_HSI;
  RCC_OscInitStruct.HSIState = RCC_HSI_ON;
  RCC_OscInitStruct.HSICalibrationValue = RCC_HSICALIBRATION_DEFAULT;
  RCC_OscInitStruct.PLL.PLLState = RCC_PLL_NONE;
  if (HAL_RCC_OscConfig(&RCC_OscInitStruct) != HAL_OK)
  {
    Error_Handler();
  }

  /** Initializes the CPU, AHB and APB buses clocks
  */
  RCC_ClkInitStruct.ClockType = RCC_CLOCKTYPE_HCLK|RCC_CLOCKTYPE_SYSCLK
                              |RCC_CLOCKTYPE_PCLK1|RCC_CLOCKTYPE_PCLK2;
  RCC_ClkInitStruct.SYSCLKSource = RCC_SYSCLKSOURCE_HSI;
  RCC_ClkInitStruct.AHBCLKDivider = RCC_SYSCLK_DIV1;
  RCC_ClkInitStruct.APB1CLKDivider = RCC_HCLK_DIV1;
  RCC_ClkInitStruct.APB2CLKDivider = RCC_HCLK_DIV1;

  if (HAL_RCC_ClockConfig(&RCC_ClkInitStruct, FLASH_ACR_LATENCY_0WS) != HAL_OK)
  {
    Error_Handler();
  }
}

static void MX_GPIO_Init(void)
{

  /* GPIO Ports Clock Enable */
  __HAL_RCC_GPIOA_CLK_ENABLE();

}

void Error_Handler(void)
{
  __disable_irq();
  while (1)
  {
  }
}
